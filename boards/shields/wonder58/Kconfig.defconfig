## boards/shields/wonder58/Kconfig.defconfig
```kconfig
if SHIELD_WONDER58_LEFT

# Name must be less than 16 characters long!
config ZMK_KEYBOARD_NAME
    default "Wonder58"

config ZMK_SPLIT_ROLE_CENTRAL
    default y

config ZMK_SPLIT_BLE_CENTRAL_BATTERY_LEVEL_PROXY
    default y

config ZMK_SPLIT_BLE_CENTRAL_BATTERY_LEVEL_FETCHING
    default y

endif

if SHIELD_WONDER58_LEFT || SHIELD_WONDER58_RIGHT

config ZMK_SPLIT
    default y

endif
```

## config/west.yml
```yaml
manifest:
  remotes:
    - name: zmkfirmware
      url-base: https://github.com/zmkfirmware
    # Additional modules containing boards/shields/custom code can be listed here as well
    # See https://docs.zephyrproject.org/3.2.0/develop/west/manifest.html#projects
    - name: caksoylar  # <-- new entry
      url-base: https://github.com/caksoylar
    - name: badjeff
      url-base: https://github.com/badjeff
  projects:
    - name: zmk
      remote: zmkfirmware
      revision: v0.3
      import: app/west.yml
    - name: zmk-rgbled-widget  # <-- new entry
      remote: caksoylar
      revision: v0.3
    - name: zmk-behavior-battery-percentage-printer
      remote: badjeff
      revision: main
    - name: zmk-behavior-insomnia
      remote: badjeff
      revision: main
  self:
    path: config
```
