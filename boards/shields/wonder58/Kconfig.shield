## boards/shields/wonder58/Kconfig.shield
```kconfig
# No whitespace after the comma or in your part name!
config SHIELD_WONDER58_LEFT
    def_bool $(shields_list_contains,wonder58_left)

# No whitespace after the comma or in your part name!
config SHIELD_WONDER58_RIGHT
    def_bool $(shields_list_contains,wonder58_right)
```
